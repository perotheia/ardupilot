## libraries/AP_HAL_Zephyr/dts/bindings/ardupilot,force-joystick.yaml
```yaml
description: |
  Force joystick (ESP32-C3 + 2 HX711, wc-hardware docs/JOYSTICK-FRAME.md v1) on a UART, with a hard-wired grip
  enable line, read by AP_HAL_Zephyr's joystick source (CONFIG_AP_HAL_ZEPHYR_FORCE_JOYSTICK).

compatible: "ardupilot,force-joystick"

properties:
  uart:
    type: phandle
    required: true
    description: the UART the stick's frames arrive on (115200 8N1)
  enable-gpios:
    type: phandle-array
    required: true
    description: grip enable (active = grip held)
```

## libraries/AP_HAL_Zephyr/dts/bindings/ardupilot,motor-bridge.yaml
```yaml
description: |
  Two-sided motor bridge driven by AP_HAL_Zephyr's motor layer
  (CONFIG_AP_HAL_ZEPHYR_MOTOR_BRIDGE, libraries/AP_HAL_Zephyr/motor_bridge.c): per side
  a forward and a reverse PWM (BTS7960 RPWM/LPWM), a bridge enable and an
  electromagnetic brake release; an output-stage arm line driven as a square
  wave into a dead-man monostable; an e-stop sense input; current sense of
  each half bridge and the motor bus voltage on ADC channels.

compatible: "ardupilot,motor-bridge"

properties:
  pwms:
    type: phandle-array
    required: true
    description: left forward, left reverse, right forward, right reverse
  enable-gpios:
    type: phandle-array
    required: true
    description: left, right bridge enable (active = enabled)
  brake-gpios:
    type: phandle-array
    required: true
    description: left, right brake (active = released)
  drv-arm-gpios:
    type: phandle-array
    required: true
    description: output-stage arm (square wave while live)
  estop-gpios:
    type: phandle-array
    required: true
    description: e-stop sense (active = e-stop open)
  io-channels:
    type: phandle-array
    required: true
    description: current sense left fwd, left rev, right fwd, right rev; motor bus voltage; battery voltage
  servo-channels:
    type: array
    required: true
    description: RCOutput channels of the left and right motor (0-based; SERVO1 = 0)
  is-ma-per-mv:
    type: array
    required: true
    description: |
      current-sense scale per ADC channel, in mA per mV at the ADC ball,
      times 1000 (e.g. 86207 = 86.207 mA/mV = 11.6 mV/A)
  vmot-mv-per-mv:
    type: int
    required: true
    description: motor bus and battery mV per mV at the ADC ball (e.g. 56)
```

## libraries/AP_HAL_Zephyr/dts/bindings/perotheia,lsm6ds3-fifo.yaml
```yaml
description: |
  ST LSM6DS3 accelerometer + gyroscope read in FIFO batches by the AI-64
  camera IMU forwarder (boards/beagle/beaglebone_ai64/cam_imu.c), not by
  ArduPilot's sensor drivers. reg = the McSPI chip select.

compatible: "perotheia,lsm6ds3-fifo"

include: spi-device.yaml

properties:
  label-id:
    type: int
    required: true
    description: device id in the forwarded samples (0 = left camera, 1 = right)
```
